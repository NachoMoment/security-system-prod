## main/Kconfig.projbuild
```kconfig
menu "App Config"
    config APP_ESPNOW_CHANNEL
        int "ESPNOW fixed channel"
        range 1 14
        default 1
        help
            Primary Wi-Fi channel to lock the STA interface to for ESP-NOW RX.
            Your PIR sender must transmit on the same channel.
endmenu
```

## sdkconfig.defaults
```kconfig
# ──────────────────────────────────────────────────────────────────────────────
# Target / toolchain
# ──────────────────────────────────────────────────────────────────────────────
CONFIG_IDF_TARGET="esp32s3"
CONFIG_IDF_TARGET_ESP32S3=y

# ──────────────────────────────────────────────────────────────────────────────
# PSRAM / external RAM (recommended for camera+TFLM)
# ──────────────────────────────────────────────────────────────────────────────
CONFIG_ESP32S3_SPIRAM_SUPPORT=y
CONFIG_SPIRAM_BOOT_INIT=y
CONFIG_SPIRAM_USE_CAPS_ALLOC=y
# Allow placing .bss and allocs in external memory when appropriate
CONFIG_SPIRAM_ALLOW_BSS_SEG_EXTERNAL_MEMORY=y

# ──────────────────────────────────────────────────────────────────────────────
# Logging (keep default INFO; bump to DEBUG if you’re chasing issues)
# ──────────────────────────────────────────────────────────────────────────────
CONFIG_LOG_DEFAULT_LEVEL_INFO=y

# ──────────────────────────────────────────────────────────────────────────────
# FreeRTOS: keep runtime stats helpers enabled (useful with esp_cli)
# ──────────────────────────────────────────────────────────────────────────────
CONFIG_FREERTOS_USE_TRACE_FACILITY=y
CONFIG_FREERTOS_USE_STATS_FORMATTING_FUNCTIONS=y
CONFIG_FREERTOS_GENERATE_RUN_TIME_STATS=y

# ──────────────────────────────────────────────────────────────────────────────
# Wi-Fi / ESPNOW runtime comes from esp_wifi; no special toggles needed here.
# We *do* expose a project-level knob for the fixed ESPNOW channel:
# ──────────────────────────────────────────────────────────────────────────────
CONFIG_APP_ESPNOW_CHANNEL=1

# ──────────────────────────────────────────────────────────────────────────────
# Partition table (expects a partitions.csv in the project)
# ──────────────────────────────────────────────────────────────────────────────
CONFIG_PARTITION_TABLE_CUSTOM=y
CONFIG_PARTITION_TABLE_CUSTOM_FILENAME="partitions.csv"
CONFIG_PARTITION_TABLE_FILENAME="partitions.csv"
# CONFIG_PARTITION_TABLE_OFFSET=0x8000  # (optional, defaults to 0x8000)

# ──────────────────────────────────────────────────────────────────────────────
# Flash mode: leave default unless you know you need a specific mode
# (If your previous sdkconfig.defaults had a QIO/QOUT setting, re-add it here.)
# ──────────────────────────────────────────────────────────────────────────────
# CONFIG_FLASHMODE_QIO=y
```
